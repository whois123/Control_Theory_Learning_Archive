# file: PID_Simulation.ioc
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Mcu.Family=STM32F1
Mcu.Name=STM32F103R(C-D-E)Tx
Mcu.Package=LQFP64
NVIC.PriorityGroup=NVIC_PRIORITYGROUP_4
PA13.Mode=Serial_Wire
PA13.Signal=SYS_JTMS-SWDIO
PA14.Mode=Serial_Wire
PA14.Signal=SYS_JTCK-SWCLK
PD0-OSC_IN.Mode=HSE-External-Oscillator
PD0-OSC_IN.Signal=RCC_OSC_IN
PD1-OSC_OUT.Mode=HSE-External-Oscillator
PD1-OSC_OUT.Signal=RCC_OSC_OUT
ProjectManager.HeapSize=0x200
ProjectManager.StackSize=0x400
ProjectManager.TargetToolchain=Makefile
RCC.AHBFreq_Value=72000000
RCC.APB1CLKDivider=RCC_HCLK_DIV2
RCC.APB1Freq_Value=36000000
RCC.APB1TimFreq_Value=72000000
RCC.APB2Freq_Value=72000000
RCC.APB2TimFreq_Value=72000000
RCC.HCLKFreq_Value=72000000
RCC.PLLMUL=RCC_PLL_MUL9
RCC.PLLSourceVirtual=RCC_PLLSOURCE_HSE
RCC.SYSCLKFreq_VALUE=72000000
RCC.SYSCLKSource=RCC_SYSCLKSOURCE_PLLCLK
RCC.USBFreq_Value=72000000
board=custom

// file: Core/Src/main.c
/* USER CODE BEGIN Header */
/**
  ******************************************************************************
  * @file           : main.c
  * @brief          : Main program body
  ******************************************************************************
  * @attention
  *
  * Copyright (c) 2026 STMicroelectronics.
  * All rights reserved.
  *
  * This software is licensed under terms that can be found in the LICENSE file
  * in the root directory of this software component.
  * If no LICENSE file comes with this software, it is provided AS-IS.
  *
  ******************************************************************************
  */
/* USER CODE END Header */
#include "main.h"
#include "gpio.h"

/* USER CODE BEGIN Includes */
#include "motor_simulation.h"
#include "bsp_dwt.h"
#include "PID.h"
#include "Generate_Reference.h"
#include "Motor_FeedForward.h"
/* USER CODE END Includes */

/* USER CODE BEGIN PV */
motorObject_t Motor;

TestMode_t TestMode = ANG_CAS_SINE;
DISTURBANCE_ControlMode_t DisturbanceControlMode = MODE_ANG_CAS;

PID_t AnglePID;
PID_t VelocityPID;

float dt = 0.0f;
float t  = 0.0f;

float Current  = 0.0f;
float Velocity = 0.0f;
float Angle    = 0.0f;

float Input       = 0.0f;
float AngleRef    = 0.0f;
float VelocityRef = 0.0f;

uint32_t DWT_CNT = 0;

float VelocityRaw = 0.0f;
float VelocityFiltered = 0.0f;
float VelFilterAlpha = 0.3f;

// ===== 前馈参考历史缓存 =====
float VelRef_last  = 0.0f;
float VelRef_last2 = 0.0f;

// ===== 二阶导数保护参数 =====
float MaxAcc  = 300.0f;   // 最大角加速度限制
float MaxJerk = 20000.0f; // 最大角加加速度限制
/* USER CODE END PV */

void SystemClock_Config(void);
/* USER CODE BEGIN PFP */
void Reset_System(void)
{
  DWT_CNT = DWT->CYCCNT;

  PID_Reset(&AnglePID);
  PID_Reset(&VelocityPID);
  Motor_Object_Init(&Motor);

  Input = 0.0f;
  VelocityRef = 0.0f;
  AngleRef = 0.0f;
  VelocityFiltered = 0.0f;

  VelRef_last  = 0.0f;
  VelRef_last2 = 0.0f;

  t = 0.0f;
}

/* USER CODE END PFP */

int main(void)
{

  /* MCU Configuration--------------------------------------------------------*/

  /* Reset of all peripherals, Initializes the Flash interface and the Systick. */
  HAL_Init();

  /* Configure the system clock */
  SystemClock_Config();

  /* Initialize all configured peripherals */
  MX_GPIO_Init();
  /* USER CODE BEGIN 2 */

  DWT_Init(72);//DWT 定时器初始化
  Motor_Object_Init(&Motor);//电机初始化

  // ================= 内环：速度环 =================
  PID_Init(&VelocityPID,
          5.0f,      // Kp
          40.0f,     // Ki
          0.01f,     // Kd
          -24.0f,     // min_output
          24.0f);    // max_output

  // ================= 外环：角度环 =================
  PID_Init(&AnglePID,
          30.0f,      // Kp
          0.0f,      // Ki
          0.27f,      // Kd
          -20.0f,     // min velocity ref
          20.0f);    // max velocity ref

  Reset_System();
  /* USER CODE END 2 */

  /* Infinite loop */
  /* USER CODE BEGIN WHILE */
  while (1)
  {
    if(isnan(Input) || isnan(Velocity) || isnan(Angle))
    {
    Reset_System();
    }

    dt = DWT_GetDeltaT(&DWT_CNT);

    if(dt > 0.01f)   // 超过10ms认为异常
    {
        dt = 0.001f;
    }

    t += dt;

    // ===== 读取状态 =====
    Current  = Get_Motor_Current(&Motor);

    VelocityRaw = Get_Motor_Velocity(&Motor);
   // 一阶低通滤波
    VelocityFiltered = (1.0f - VelFilterAlpha) * VelocityFiltered
                      + VelFilterAlpha * VelocityRaw;

    Velocity = VelocityFiltered;

    Angle    = Get_Motor_Angle(&Motor);

    Generate_Reference(t);

    // ===== 控制器结构选择 =====
    switch(TestMode)
    {
        // ========= 速度闭环 =========
        case VEL_STEP:
        case VEL_RAMP:
        case VEL_SINE:

            Input = PID_Calculate(&VelocityPID,
                                  VelocityRef,
                                  Velocity,
                                  dt);
            break;

        // ========= 单级角度 =========
        case ANG_SINGLE_STEP:
        case ANG_SINGLE_SINE:

            Input = PID_Calculate(&AnglePID,
                                  AngleRef,
                                  Angle,
                                  dt);
            break;

        // ========= 串级控制 =========
        case ANG_CAS_STEP:
        case ANG_CAS_SINE:
        case ANG_DISTURBANCE:

            VelocityRef = PID_Calculate(&AnglePID,
              AngleRef,
              Angle,
              dt);

            // ===== 前馈计算 =====
            float u_ff = Motor_FeedForward(&Motor,
                        VelocityRef,
                        VelRef_last,
                        VelRef_last2,
                        dt,
                        MaxAcc,
                        MaxJerk);

            // ===== 速度内环 =====
            float u_pid = PID_Calculate(&VelocityPID,
                      VelocityRef,
                      Velocity,
                      dt);

            Input = u_pid + u_ff;

            // ===== 更新历史 =====
            VelRef_last2 = VelRef_last;
            VelRef_last  = VelocityRef;
            break;
        case OPEN_LOOP:
            Input = 24.0f;
            break;
    }

    // ===== 扰动测试 =====
    if(TestMode == ANG_DISTURBANCE)
    {
        switch (DisturbanceControlMode)
        {
            case MODE_ANG_SINGLE:

                Input = PID_Calculate(&AnglePID,
                                      AngleRef,
                                      Angle,
                                      dt);
                break;

            case MODE_ANG_CAS:

                // ===== 外环 =====
                VelocityRef = PID_Calculate(&AnglePID,
                                            AngleRef,
                                            Angle,
                                            dt);

                // ===== 前馈 =====
                float u_ff = Motor_FeedForward(&Motor,
                                               VelocityRef,
                                               VelRef_last,
                                               VelRef_last2,
                                               dt,
                                               MaxAcc,
                                               MaxJerk);

                // ===== 内环 =====
                float u_pid = PID_Calculate(&VelocityPID,
                                            VelocityRef,
                                            Velocity,
                                            dt);

                Input = u_pid + u_ff;

                // ===== 更新参考历史 =====
                VelRef_last2 = VelRef_last;
                VelRef_last  = VelocityRef;

                break;
        }

        // ===== 扰动注入 =====
        if(t > 0.5f && t < 0.7f)
            Input += 10.0f;
    }

    // ===== 电机仿真 =====
    Motor_Simulation(&Motor, Input, dt);
    /* USER CODE END WHILE */

    /* USER CODE BEGIN 3 */
    HAL_Delay(1);
  }
  /* USER CODE END 3 */
}

void SystemClock_Config(void)
{
  RCC_OscInitTypeDef RCC_OscInitStruct = {0};
  RCC_ClkInitTypeDef RCC_ClkInitStruct = {0};

  /** Initializes the RCC Oscillators according to the specified parameters
  * in the RCC_OscInitTypeDef structure.
  */
  RCC_OscInitStruct.OscillatorType = RCC_OSCILLATORTYPE_HSE;
  RCC_OscInitStruct.HSEState = RCC_HSE_ON;
  RCC_OscInitStruct.HSEPredivValue = RCC_HSE_PREDIV_DIV1;
  RCC_OscInitStruct.HSIState = RCC_HSI_ON;
  RCC_OscInitStruct.PLL.PLLState = RCC_PLL_ON;
  RCC_OscInitStruct.PLL.PLLSource = RCC_PLLSOURCE_HSE;
  RCC_OscInitStruct.PLL.PLLMUL = RCC_PLL_MUL9;
  if (HAL_RCC_OscConfig(&RCC_OscInitStruct) != HAL_OK)
  {
    Error_Handler();
  }

  /** Initializes the CPU, AHB and APB buses clocks
  */
  RCC_ClkInitStruct.ClockType = RCC_CLOCKTYPE_HCLK|RCC_CLOCKTYPE_SYSCLK
                              |RCC_CLOCKTYPE_PCLK1|RCC_CLOCKTYPE_PCLK2;
  RCC_ClkInitStruct.SYSCLKSource = RCC_SYSCLKSOURCE_PLLCLK;
  RCC_ClkInitStruct.AHBCLKDivider = RCC_SYSCLK_DIV1;
  RCC_ClkInitStruct.APB1CLKDivider = RCC_HCLK_DIV2;
  RCC_ClkInitStruct.APB2CLKDivider = RCC_HCLK_DIV1;

  if (HAL_RCC_ClockConfig(&RCC_ClkInitStruct, FLASH_LATENCY_2) != HAL_OK)
  {
    Error_Handler();
  }
}

void Error_Handler(void)
{
  __disable_irq();
  while (1)
  {
  }
}
